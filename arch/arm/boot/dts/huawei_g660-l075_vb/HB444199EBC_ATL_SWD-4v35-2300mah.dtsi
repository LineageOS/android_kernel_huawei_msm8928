
/* Copyright (c) 2013, The Linux Foundation. All rights reserved.
 *
 * This program is free software; you can redistribute it and/or modify
 * it under the terms of the GNU General Public License version 2 and
 * only version 2 as published by the Free Software Foundation.
 *
 * This program is distributed in the hope that it will be useful,
 * but WITHOUT ANY WARRANTY; without even the implied warranty of
 * MERCHANTABILITY or FITNESS FOR A PARTICULAR PURPOSE.  See the
 * GNU General Public License for more details.
 */

qcom,qrd-4v35-2300mAh-swd-data {
	qcom,fcc-mah = <2300>;
	qcom,default-rbatt-mohm = <154>;
	qcom,rbatt-capacitive-mohm = <0>;
	qcom,flat-ocv-threshold-uv = <3800000>;
	qcom,max-voltage-uv = <4350000>;
	qcom,v-cutoff-uv = <3400000>;
	qcom,chg-term-ua = <100000>;
	qcom,batt-id-kohm = <10>;
	qcom,batt-name = "HB444199EBC_ATL_SWD";

	qcom,warm-bat-decidegc = <420>;
	qcom,warm-bat-mv = <4250>;
	qcom,ibatmax-warm-ma = <700>;

	qcom,cool-bat-decidegc = <100>;
	qcom,cool-bat-mv = <4350>;
	qcom,ibatmax-cool-ma = <600>;

	qcom,hot-bat-decidegc = <520>;
	qcom,cold-bat-decidegc = <0>;

	qcom,rbatt-sf-lut {
		qcom,lut-col-legend = <(-20) 0 25 40 60>;
		qcom,lut-row-legend = <100 95 90 85 80>,
				<75 70 65 60 55>,
				<50 45 40 35 30>,
				<25 20 16 13 11>,
				<10 9 8 7 6>,
				<5 4 3 2 1>,
				<0>;
		qcom,lut-data = <844 231 100 85 81>,
				<844 232 100 85 81>,
				<846 237 101 85 81>,
				<846 241 103 87 82>,
				<857 238 107 88 83>,
				<820 238 112 90 84>,
				<826 228 117 94 86>,
				<827 224 116 98 88>,
				<832 224 104 93 87>,
				<855 224 99 86 83>,
				<898 224 99 86 82>,
				<950 226 100 87 83>,
				<1011 225 102 88 84>,
				<1085 231 103 90 86>,
				<1171 244 101 88 83>,
				<1274 262 101 85 81>,
				<1409 290 103 86 82>,
				<1642 335 107 88 83>,
				<1908 384 107 88 82>,
				<2075 403 107 88 83>,
				<2341 429 111 90 84>,
				<2685 461 114 91 85>,
				<3129 500 119 93 86>,
				<3722 548 124 94 86>,
				<4498 612 123 94 85>,
				<5585 704 126 94 85>,
				<7112 838 134 96 87>,
				<9375 1059 148 100 90>,
				<12898 1509 172 106 94>,
				<18820 2551 375 127 109>,
				<31598 6237 2657 1726 1037>;
	};

	qcom,fcc-temp-lut {
		qcom,lut-col-legend = <(-20) 0 25 40 60>;
		qcom,lut-data = <2353 2351 2351 2354 2350>;
	};

	qcom,pc-temp-ocv-lut {
		qcom,lut-col-legend = <(-20) 0 25 40 60>;
		qcom,lut-row-legend = <100 95 90 85 80>,
				<75 70 65 60 55>,
				<50 45 40 35 30>,
				<25 20 16 13 11>,
				<10 9 8 7 6>,
				<5 4 3 2 1>,
				<0>;
		qcom,lut-data = <4330 4322 4316 4319 4318>,
				<4230 4250 4252 4254 4251>,
				<4157 4190 4194 4196 4193>,
				<4091 4132 4139 4140 4137>,
				<4038 4075 4086 4087 4084>,
				<3964 4020 4037 4038 4035>,
				<3918 3965 3989 3992 3990>,
				<3874 3922 3942 3949 3947>,
				<3834 3884 3895 3901 3900>,
				<3806 3851 3859 3861 3859>,
				<3789 3823 3832 3833 3832>,
				<3774 3799 3810 3811 3809>,
				<3760 3778 3792 3793 3791>,
				<3744 3763 3776 3777 3774>,
				<3727 3749 3760 3758 3752>,
				<3707 3733 3743 3737 3725>,
				<3683 3713 3724 3717 3704>,
				<3658 3698 3704 3698 3685>,
				<3633 3686 3684 3679 3666>,
				<3616 3677 3676 3671 3660>,
				<3604 3671 3673 3669 3658>,
				<3590 3663 3669 3666 3655>,
				<3574 3652 3663 3661 3649>,
				<3556 3634 3653 3651 3639>,
				<3534 3610 3627 3628 3611>,
				<3509 3578 3586 3589 3571>,
				<3476 3536 3534 3539 3522>,
				<3432 3479 3469 3478 3461>,
				<3370 3399 3380 3396 3379>,
				<3262 3265 3251 3272 3253>,
				<3000 3000 3000 3000 3000>;
	};
};
