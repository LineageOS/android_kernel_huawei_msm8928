/* Copyright (c) 2013, The Linux Foundation. All rights reserved.
 *
 * This program is free software; you can redistribute it and/or modify
 * it under the terms of the GNU General Public License version 2 and
 * only version 2 as published by the Free Software Foundation.
 *
 * This program is distributed in the hope that it will be useful,
 * but WITHOUT ANY WARRANTY; without even the implied warranty of
 * MERCHANTABILITY or FITNESS FOR A PARTICULAR PURPOSE.  See the
 * GNU General Public License for more details.
 */

qcom,qrd-4v35-2300mAh-lishen-data {
	qcom,fcc-mah = <2300>;
	qcom,default-rbatt-mohm = <159>;
	qcom,rbatt-capacitive-mohm = <0>;
	qcom,flat-ocv-threshold-uv = <3800000>;
	qcom,max-voltage-uv = <4350000>;
	qcom,v-cutoff-uv = <3400000>;
	qcom,chg-term-ua = <100000>;
	qcom,batt-id-kohm = <39>;
	qcom,batt-name = "HB444199EBC_LS_LS";

	qcom,warm-bat-decidegc = <420>;
	qcom,warm-bat-mv = <4250>;
	qcom,ibatmax-warm-ma = <800>;

	qcom,cool-bat-decidegc = <100>;
	qcom,cool-bat-mv = <4350>;
	qcom,ibatmax-cool-ma = <600>;

	qcom,hot-bat-decidegc = <520>;
	qcom,cold-bat-decidegc = <0>;

	qcom,rbatt-sf-lut {
		qcom,lut-col-legend = <(-20) 0 25 40 60>;
		qcom,lut-row-legend = <100 95 90 85 80>,
				<75 70 65 60 55>,
				<50 45 40 35 30>,
				<25 20 16 13 11>,
				<10 9 8 7 6>,
				<5 4 3 2 1>,
				<0>;
		qcom,lut-data = <1491 271 100 81 74>,
				<1419 271 100 81 74>,
				<1420 273 101 81 74>,
				<1377 276 102 83 75>,
				<1276 274 106 84 76>,
				<1262 287 113 87 78>,
				<1255 251 118 91 80>,
				<1261 255 125 98 83>,
				<1276 253 108 99 89>,
				<1295 257 98 83 77>,
				<1318 263 98 81 76>,
				<1340 274 98 83 77>,
				<1367 288 102 85 79>,
				<1401 306 103 88 81>,
				<1448 327 107 88 81>,
				<1605 355 105 85 78>,
				<1961 386 106 83 77>,
				<2396 433 106 83 77>,
				<2856 493 106 83 77>,
				<3216 538 108 84 77>,
				<3217 548 109 85 79>,
				<3417 580 113 88 79>,
				<3839 615 116 89 81>,
				<4372 653 121 91 81>,
				<5039 691 125 91 81>,
				<5890 742 126 89 79>,
				<7033 813 129 91 80>,
				<8705 903 137 96 83>,
				<13247 1110 156 111 89>,
				<39015 6519 583 470 205>,
				<77245 39858 29754 22144 7148>;
	};

	qcom,fcc-temp-lut {
		qcom,lut-col-legend = <(-20) 0 25 40 60>;
		qcom,lut-data = <2290 2306 2304 2304 2300>;
	};

	qcom,pc-temp-ocv-lut {
		qcom,lut-col-legend = <(-20) 0 25 40 60>;
		qcom,lut-row-legend = <100 95 90 85 80>,
				<75 70 65 60 55>,
				<50 45 40 35 30>,
				<25 20 16 13 11>,
				<10 9 8 7 6>,
				<5 4 3 2 1>,
				<0>;
		qcom,lut-data = <4322 4325 4315 4312 4317>,
				<4212 4248 4252 4251 4253>,
				<4132 4188 4196 4196 4197>,
				<4079 4134 4143 4143 4143>,
				<3985 4084 4092 4092 4092>,
				<3939 4030 4049 4045 4045>,
				<3898 3956 3995 4000 4001>,
				<3865 3923 3958 3961 3961>,
				<3840 3886 3907 3916 3921>,
				<3820 3854 3867 3870 3871>,
				<3802 3827 3839 3841 3842>,
				<3786 3804 3816 3818 3819>,
				<3772 3788 3798 3799 3799>,
				<3757 3777 3782 3783 3783>,
				<3743 3766 3769 3766 3763>,
				<3727 3752 3755 3748 3737>,
				<3708 3728 3737 3728 3716>,
				<3687 3710 3712 3704 3693>,
				<3666 3699 3691 3683 3671>,
				<3647 3692 3687 3680 3669>,
				<3637 3688 3685 3679 3668>,
				<3623 3684 3684 3678 3667>,
				<3606 3677 3681 3676 3665>,
				<3584 3664 3677 3671 3661>,
				<3558 3639 3664 3658 3650>,
				<3522 3602 3633 3626 3617>,
				<3471 3554 3586 3576 3569>,
				<3397 3490 3522 3512 3507>,
				<3291 3405 3437 3427 3424>,
				<3173 3287 3307 3293 3295>,
				<3000 3000 3000 3000 3000>;
	};
};
