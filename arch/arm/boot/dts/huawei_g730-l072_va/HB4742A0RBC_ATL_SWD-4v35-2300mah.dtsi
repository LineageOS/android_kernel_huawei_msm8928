/* Copyright (c) 2013, The Linux Foundation. All rights reserved.
 *
 * This program is free software; you can redistribute it and/or modify
 * it under the terms of the GNU General Public License version 2 and
 * only version 2 as published by the Free Software Foundation.
 *
 * This program is distributed in the hope that it will be useful,
 * but WITHOUT ANY WARRANTY; without even the implied warranty of
 * MERCHANTABILITY or FITNESS FOR A PARTICULAR PURPOSE.  See the
 * GNU General Public License for more details.
 */

qcom,qrd-4v35-2300mAh-swd-data {
	qcom,fcc-mah = <2300>;
	qcom,default-rbatt-mohm = <123>;
	qcom,rbatt-capacitive-mohm = <0>;
	qcom,flat-ocv-threshold-uv = <3800000>;
	qcom,max-voltage-uv = <4350000>;
	qcom,v-cutoff-uv = <3400000>;
	qcom,chg-term-ua = <100000>;
	qcom,batt-id-kohm = <22>;
	qcom,batt-name = "HB4742A0RBC_ATL_SWD";

	qcom,warm-bat-decidegc = <420>;
	qcom,warm-bat-mv = <4100>;
	qcom,ibatmax-warm-ma = <800>;

	qcom,cool-bat-decidegc = <100>;
	qcom,cool-bat-mv = <4350>;
	qcom,ibatmax-cool-ma = <600>;

	qcom,hot-bat-decidegc = <520>;
	qcom,cold-bat-decidegc = <0>;

	qcom,rbatt-sf-lut {
		qcom,lut-col-legend = <(-20) 0 25 40 60>;
		qcom,lut-row-legend = <100 95 90 85 80>,
				<75 70 65 60 55>,
				<50 45 40 35 30>,
				<25 20 16 13 11>,
				<10 9 8 7 6>,
				<5 4 3 2 1>,
				<0>;
		qcom,lut-data = <1030 278 100 78 72>,
				<1030 278 100 78 72>,
				<1046 285 101 80 73>,
				<1046 286 104 82 73>,
				<1065 282 108 84 76>,
				<1028 282 113 86 77>,
				<1028 269 121 90 79>,
				<1030 266 121 95 82>,
				<1032 263 104 88 79>,
				<1043 263 98 81 74>,
				<1082 264 99 81 75>,
				<1134 265 101 82 75>,
				<1197 266 104 84 77>,
				<1269 269 107 86 79>,
				<1354 285 104 86 78>,
				<1472 305 101 79 74>,
				<1761 330 103 81 74>,
				<2063 363 106 82 74>,
				<2328 402 108 83 75>,
				<2365 411 104 82 74>,
				<2449 426 106 82 75>,
				<2656 443 107 83 75>,
				<2916 469 112 86 77>,
				<3227 500 116 86 78>,
				<3625 531 121 89 78>,
				<4121 565 125 89 78>,
				<4759 615 122 88 77>,
				<5599 680 125 90 78>,
				<6701 778 131 92 79>,
				<8251 926 142 95 82>,
				<10445 1253 158 102 85>;
	};

	qcom,fcc-temp-lut {
		qcom,lut-col-legend = <(-20) 0 25 40 60>;
		qcom,lut-data = <2316 2325 2321 2328 2322>;
	};

	qcom,pc-temp-ocv-lut {
		qcom,lut-col-legend = <(-20) 0 25 40 60>;
		qcom,lut-row-legend = <100 95 90 85 80>,
				<75 70 65 60 55>,
				<50 45 40 35 30>,
				<25 20 16 13 11>,
				<10 9 8 7 6>,
				<5 4 3 2 1>,
				<0>;
		qcom,lut-data = <4334 4327 4321 4324 4323>,
				<4239 4258 4261 4263 4260>,
				<4170 4200 4204 4206 4203>,
				<4104 4143 4149 4150 4148>,
				<4053 4086 4097 4098 4096>,
				<3983 4033 4047 4049 4047>,
				<3933 3977 4000 4003 4001>,
				<3889 3934 3954 3959 3959>,
				<3849 3894 3904 3910 3910>,
				<3815 3861 3868 3870 3869>,
				<3795 3832 3840 3841 3840>,
				<3779 3806 3818 3818 3817>,
				<3765 3784 3798 3799 3798>,
				<3749 3767 3782 3783 3781>,
				<3734 3754 3765 3765 3761>,
				<3716 3739 3748 3742 3731>,
				<3695 3719 3731 3723 3711>,
				<3674 3703 3713 3706 3694>,
				<3655 3693 3697 3690 3678>,
				<3641 3686 3684 3677 3666>,
				<3633 3682 3680 3674 3663>,
				<3623 3677 3677 3672 3661>,
				<3613 3671 3675 3670 3659>,
				<3600 3665 3671 3666 3656>,
				<3585 3654 3665 3661 3651>,
				<3568 3635 3655 3651 3640>,
				<3547 3610 3630 3627 3615>,
				<3523 3576 3591 3588 3578>,
				<3493 3534 3542 3540 3531>,
				<3454 3478 3481 3479 3474>,
				<3400 3400 3400 3400 3400>;
	};
};
