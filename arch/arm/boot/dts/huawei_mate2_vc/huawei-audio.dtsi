/ {
    huawei_audio_info {
        compatible = "huawei,hw_audio_info";
        product-identifier = "mate2";
        builtin-master-mic-exist;
        builtin-2nd-mic-exist;
        hand_held_dual_mic_strategy;
        status = "ok";
        aud_param_ver = "MT2L03_audio_C07";
        product-btsco-nrec-adapt;
        loud_speaker_second_mic_strategy;
    };
};
&soc {
    /delete-node/ sound;
    sound-9302 {
        qcom,audio-routing =
            "RX_BIAS", "MCLK",
            "LDO_H", "MCLK",
            "SPK_OUT", "MCLK",
	    "SPK_OUT", "EXT_VDD_SPKR",
            "AMIC1", "MIC BIAS1 External",
            "MIC BIAS1 External", "Handset Mic",
            "AMIC2", "MIC BIAS2 External",
            "MIC BIAS2 External", "Headset Mic",
            "AMIC3", "MIC BIAS1 External",
            "MIC BIAS1 External", "Analog Mic3",
            "AMIC4", "MIC BIAS1 External",
            "MIC BIAS1 External", "Analog Mic4";

        qcom,cdc-vdd-spkr-gpios = <&msmgpio 111 0>;
        /delete-property/ qcom,headset-jack-type-NC;
    };
};
